## Kconfig.demuxers
```kconfig
config AAC_DEMUXER
	int "AAC_DEMUXER"
	default "1"
config AC3_DEMUXER
	int "AC3_DEMUXER"
	default "1"
config AEA_DEMUXER
	int "AEA_DEMUXER"
	default "1"
config AIFF_DEMUXER
	int "AIFF_DEMUXER"
	default "1"
config AMR_DEMUXER
	int "AMR_DEMUXER"
	default "1"
config APC_DEMUXER
	int "APC_DEMUXER"
	default "1"
config APE_DEMUXER
	int "APE_DEMUXER"
	default "1"
config ASF_DEMUXER
	int "ASF_DEMUXER"
	default "1"
config ASS_DEMUXER
	int "ASS_DEMUXER"
	default "1"
config AU_DEMUXER
	int "AU_DEMUXER"
	default "1"
config AVI_DEMUXER
	int "AVI_DEMUXER"
	default "1"
config AVS_DEMUXER
	int "AVS_DEMUXER"
	default "1"
config BETHSOFTVID_DEMUXER
	int "BETHSOFTVID_DEMUXER"
	default "1"
config BFI_DEMUXER
	int "BFI_DEMUXER"
	default "1"
config C93_DEMUXER
	int "C93_DEMUXER"
	default "1"
config CAF_DEMUXER
	int "CAF_DEMUXER"
	default "0"
config CAVSVIDEO_DEMUXER
	int "CAVSVIDEO_DEMUXER"
	default "1"
config DAUD_DEMUXER
	int "DAUD_DEMUXER"
	default "1"
config DIRAC_DEMUXER
	int "DIRAC_DEMUXER"
	default "1"
config DNXHD_DEMUXER
	int "DNXHD_DEMUXER"
	default "0"
config DSICIN_DEMUXER
	int "DSICIN_DEMUXER"
	default "1"
config DTS_DEMUXER
	int "DTS_DEMUXER"
	default "1"
config DV_DEMUXER
	int "DV_DEMUXER"
	default "1"
config DXA_DEMUXER
	int "DXA_DEMUXER"
	default "1"
config EA_DEMUXER
	int "EA_DEMUXER"
	default "1"
config EA_CDATA_DEMUXER
	int "EA_CDATA_DEMUXER"
	default "1"
config EAC3_DEMUXER
	int "EAC3_DEMUXER"
	default "1"
config FFM_DEMUXER
	int "FFM_DEMUXER"
	default "1"
config FLAC_DEMUXER
	int "FLAC_DEMUXER"
	default "1"
config FLIC_DEMUXER
	int "FLIC_DEMUXER"
	default "1"
config FLV_DEMUXER
	int "FLV_DEMUXER"
	default "1"
config FOURXM_DEMUXER
	int "FOURXM_DEMUXER"
	default "1"
config GSM_DEMUXER
	int "GSM_DEMUXER"
	default "1"
config GXF_DEMUXER
	int "GXF_DEMUXER"
	default "1"
config H261_DEMUXER
	int "H261_DEMUXER"
	default "1"
config H263_DEMUXER
	int "H263_DEMUXER"
	default "1"
config H264_DEMUXER
	int "H264_DEMUXER"
	default "1"
config IDCIN_DEMUXER
	int "IDCIN_DEMUXER"
	default "1"
config IFF_DEMUXER
	int "IFF_DEMUXER"
	default "1"
config IMAGE2_DEMUXER
	int "IMAGE2_DEMUXER"
	default "1"
config IMAGE2PIPE_DEMUXER
	int "IMAGE2PIPE_DEMUXER"
	default "1"
config INGENIENT_DEMUXER
	int "INGENIENT_DEMUXER"
	default "1"
config IPMOVIE_DEMUXER
	int "IPMOVIE_DEMUXER"
	default "1"
config ISS_DEMUXER
	int "ISS_DEMUXER"
	default "1"
config LMLM4_DEMUXER
	int "LMLM4_DEMUXER"
	default "1"
config M4V_DEMUXER
	int "M4V_DEMUXER"
	default "1"
config MATROSKA_DEMUXER
	int "MATROSKA_DEMUXER"
	default "1"
config MJPEG_DEMUXER
	int "MJPEG_DEMUXER"
	default "1"
config MLP_DEMUXER
	int "MLP_DEMUXER"
	default "1"
config MM_DEMUXER
	int "MM_DEMUXER"
	default "1"
config MMF_DEMUXER
	int "MMF_DEMUXER"
	default "1"
config MOV_DEMUXER
	int "MOV_DEMUXER"
	default "1"
config MP3_DEMUXER
	int "MP3_DEMUXER"
	default "1"
config MPC_DEMUXER
	int "MPC_DEMUXER"
	default "1"
config MPC8_DEMUXER
	int "MPC8_DEMUXER"
	default "1"
config MPEGPS_DEMUXER
	int "MPEGPS_DEMUXER"
	default "0"
config MPEGTS_DEMUXER
	int "MPEGTS_DEMUXER"
	default "0"
config MPEGTSRAW_DEMUXER
	int "MPEGTSRAW_DEMUXER"
	default "0"
config MPEGVIDEO_DEMUXER
	int "MPEGVIDEO_DEMUXER"
	default "0"
config MSNWC_TCP_DEMUXER
	int "MSNWC_TCP_DEMUXER"
	default "1"
config MTV_DEMUXER
	int "MTV_DEMUXER"
	default "1"
config MVI_DEMUXER
	int "MVI_DEMUXER"
	default "1"
config MXF_DEMUXER
	int "MXF_DEMUXER"
	default "1"
config NC_DEMUXER
	int "NC_DEMUXER"
	default "1"
config NSV_DEMUXER
	int "NSV_DEMUXER"
	default "1"
config NUT_DEMUXER
	int "NUT_DEMUXER"
	default "1"
config NUV_DEMUXER
	int "NUV_DEMUXER"
	default "1"
config OGG_DEMUXER
	int "OGG_DEMUXER"
	default "1"
config OMA_DEMUXER
	int "OMA_DEMUXER"
	default "1"
config PCM_ALAW_DEMUXER
	int "PCM_ALAW_DEMUXER"
	default "1"
config PCM_MULAW_DEMUXER
	int "PCM_MULAW_DEMUXER"
	default "1"
config PCM_F64BE_DEMUXER
	int "PCM_F64BE_DEMUXER"
	default "1"
config PCM_F64LE_DEMUXER
	int "PCM_F64LE_DEMUXER"
	default "1"
config PCM_F32BE_DEMUXER
	int "PCM_F32BE_DEMUXER"
	default "1"
config PCM_F32LE_DEMUXER
	int "PCM_F32LE_DEMUXER"
	default "1"
config PCM_S32BE_DEMUXER
	int "PCM_S32BE_DEMUXER"
	default "1"
config PCM_S32LE_DEMUXER
	int "PCM_S32LE_DEMUXER"
	default "1"
config PCM_S24BE_DEMUXER
	int "PCM_S24BE_DEMUXER"
	default "1"
config PCM_S24LE_DEMUXER
	int "PCM_S24LE_DEMUXER"
	default "1"
config PCM_S16BE_DEMUXER
	int "PCM_S16BE_DEMUXER"
	default "1"
config PCM_S16LE_DEMUXER
	int "PCM_S16LE_DEMUXER"
	default "1"
config PCM_S8_DEMUXER
	int "PCM_S8_DEMUXER"
	default "1"
config PCM_U32BE_DEMUXER
	int "PCM_U32BE_DEMUXER"
	default "1"
config PCM_U32LE_DEMUXER
	int "PCM_U32LE_DEMUXER"
	default "1"
config PCM_U24BE_DEMUXER
	int "PCM_U24BE_DEMUXER"
	default "1"
config PCM_U24LE_DEMUXER
	int "PCM_U24LE_DEMUXER"
	default "1"
config PCM_U16BE_DEMUXER
	int "PCM_U16BE_DEMUXER"
	default "1"
config PCM_U16LE_DEMUXER
	int "PCM_U16LE_DEMUXER"
	default "1"
config PCM_U8_DEMUXER
	int "PCM_U8_DEMUXER"
	default "1"
config PVA_DEMUXER
	int "PVA_DEMUXER"
	default "1"
config QCP_DEMUXER
	int "QCP_DEMUXER"
	default "1"
config R3D_DEMUXER
	int "R3D_DEMUXER"
	default "1"
config RAWVIDEO_DEMUXER
	int "RAWVIDEO_DEMUXER"
	default "1"
config RL2_DEMUXER
	int "RL2_DEMUXER"
	default "1"
config RM_DEMUXER
	int "RM_DEMUXER"
	default "1"
config ROQ_DEMUXER
	int "ROQ_DEMUXER"
	default "1"
config RPL_DEMUXER
	int "RPL_DEMUXER"
	default "1"
config SEGAFILM_DEMUXER
	int "SEGAFILM_DEMUXER"
	default "1"
config SHORTEN_DEMUXER
	int "SHORTEN_DEMUXER"
	default "1"
config SIFF_DEMUXER
	int "SIFF_DEMUXER"
	default "1"
config SMACKER_DEMUXER
	int "SMACKER_DEMUXER"
	default "1"
config SOL_DEMUXER
	int "SOL_DEMUXER"
	default "1"
config SOX_DEMUXER
	int "SOX_DEMUXER"
	default "1"
config STR_DEMUXER
	int "STR_DEMUXER"
	default "1"
config SWF_DEMUXER
	int "SWF_DEMUXER"
	default "1"
config THP_DEMUXER
	int "THP_DEMUXER"
	default "1"
config TIERTEXSEQ_DEMUXER
	int "TIERTEXSEQ_DEMUXER"
	default "1"
config TMV_DEMUXER
	int "TMV_DEMUXER"
	default "1"
config TRUEHD_DEMUXER
	int "TRUEHD_DEMUXER"
	default "1"
config TTA_DEMUXER
	int "TTA_DEMUXER"
	default "1"
config TXD_DEMUXER
	int "TXD_DEMUXER"
	default "1"
config VC1_DEMUXER
	int "VC1_DEMUXER"
	default "1"
config VC1T_DEMUXER
	int "VC1T_DEMUXER"
	default "1"
config VMD_DEMUXER
	int "VMD_DEMUXER"
	default "1"
config VOC_DEMUXER
	int "VOC_DEMUXER"
	default "1"
config VQF_DEMUXER
	int "VQF_DEMUXER"
	default "1"
config W64_DEMUXER
	int "W64_DEMUXER"
	default "1"
config WAV_DEMUXER
	int "WAV_DEMUXER"
	default "1"
config WC3_DEMUXER
	int "WC3_DEMUXER"
	default "1"
config WSAUD_DEMUXER
	int "WSAUD_DEMUXER"
	default "1"
config WSVQA_DEMUXER
	int "WSVQA_DEMUXER"
	default "1"
config WV_DEMUXER
	int "WV_DEMUXER"
	default "1"
config XA_DEMUXER
	int "XA_DEMUXER"
	default "1"
config YUV4MPEGPIPE_DEMUXER
	int "YUV4MPEGPIPE_DEMUXER"
	default "0"

config AVISYNTH_DEMUXER
	int "AVISYNTH_DEMUXER"
	default "0"
config RTSP_DEMUXER
	int "RTSP_DEMUXER"
	default "0"
config SDP_DEMUXER
	int "SDP_DEMUXER"
	default "0"
config LIBNUT_DEMUXER
	int "LIBNUT_DEMUXER"
	default "0"
config ANM_DEMUXER
	int "ANM_DEMUXER"
	default "0"
config CDG_DEMUXER
	int "CDG_DEMUXER"
	default "0"
config FILMSTRIP_DEMUXER
	int "FILMSTRIP_DEMUXER"
	default "0"
config IV8_DEMUXER
	int "IV8_DEMUXER"
	default "0"
```

## Kconfig.encoders
```kconfig
config ASV1_ENCODER
	int "ASV1_ENCODER"
	default "1"
config ASV2_ENCODER
	int "ASV2_ENCODER"
	default "1"
config BMP_ENCODER
	int "BMP_ENCODER"
	default "1"
config DNXHD_ENCODER
	int "DNXHD_ENCODER"
	default "0"
config DVVIDEO_ENCODER
	int "DVVIDEO_ENCODER"
	default "1"
config FFV1_ENCODER
	int "FFV1_ENCODER"
	default "1"
config FFVHUFF_ENCODER
	int "FFVHUFF_ENCODER"
	default "1"
config FLASHSV_ENCODER
	int "FLASHSV_ENCODER"
	default "1"
config FLV_ENCODER
	int "FLV_ENCODER"
	default "0"
config GIF_ENCODER
	int "GIF_ENCODER"
	default "1"
config H261_ENCODER
	int "H261_ENCODER"
	default "0"
config H263_ENCODER
	int "H263_ENCODER"
	default "0"
config H263P_ENCODER
	int "H263P_ENCODER"
	default "0"
config HUFFYUV_ENCODER
	int "HUFFYUV_ENCODER"
	default "1"
config JPEGLS_ENCODER
	int "JPEGLS_ENCODER"
	default "1"
config LJPEG_ENCODER
	int "LJPEG_ENCODER"
	default "0"
config MJPEG_ENCODER
	int "MJPEG_ENCODER"
	default "0"
config MPEG1VIDEO_ENCODER
	int "MPEG1VIDEO_ENCODER"
	default "0"
config MPEG2VIDEO_ENCODER
	int "MPEG2VIDEO_ENCODER"
	default "0"
config MPEG4_ENCODER
	int "MPEG4_ENCODER"
	default "0"
config MSMPEG4V1_ENCODER
	int "MSMPEG4V1_ENCODER"
	default "0"
config MSMPEG4V2_ENCODER
	int "MSMPEG4V2_ENCODER"
	default "0"
config MSMPEG4V3_ENCODER
	int "MSMPEG4V3_ENCODER"
	default "0"
config PAM_ENCODER
	int "PAM_ENCODER"
	default "1"
config PBM_ENCODER
	int "PBM_ENCODER"
	default "1"
config PCX_ENCODER
	int "PCX_ENCODER"
	default "1"
config PGM_ENCODER
	int "PGM_ENCODER"
	default "1"
config PGMYUV_ENCODER
	int "PGMYUV_ENCODER"
	default "1"
config PNG_ENCODER
	int "PNG_ENCODER"
	default "1"
config PPM_ENCODER
	int "PPM_ENCODER"
	default "1"
config QTRLE_ENCODER
	int "QTRLE_ENCODER"
	default "1"
config RAWVIDEO_ENCODER
	int "RAWVIDEO_ENCODER"
	default "1"
config ROQ_ENCODER
	int "ROQ_ENCODER"
	default "1"
config RV10_ENCODER
	int "RV10_ENCODER"
	default "1"
config RV20_ENCODER
	int "RV20_ENCODER"
	default "1"
config SGI_ENCODER
	int "SGI_ENCODER"
	default "1"
config SNOW_ENCODER
	int "SNOW_ENCODER"
	default "0"
config SVQ1_ENCODER
	int "SVQ1_ENCODER"
	default "0"
config TARGA_ENCODER
	int "TARGA_ENCODER"
	default "1"
config TIFF_ENCODER
	int "TIFF_ENCODER"
	default "1"
config V210_ENCODER
	int "V210_ENCODER"
	default "1"
config WMV1_ENCODER
	int "WMV1_ENCODER"
	default "0"
config WMV2_ENCODER
	int "WMV2_ENCODER"
	default "0"
config ZLIB_ENCODER
	int "ZLIB_ENCODER"
	default "1"
config ZMBV_ENCODER
	int "ZMBV_ENCODER"
	default "1"
config AC3_ENCODER
	int "AC3_ENCODER"
	default "1"
config ALAC_ENCODER
	int "ALAC_ENCODER"
	default "1"
config FLAC_ENCODER
	int "FLAC_ENCODER"
	default "1"
config MP2_ENCODER
	int "MP2_ENCODER"
	default "1"
config NELLYMOSER_ENCODER
	int "NELLYMOSER_ENCODER"
	default "1"
config SONIC_ENCODER
	int "SONIC_ENCODER"
	default "1"
config SONIC_LS_ENCODER
	int "SONIC_LS_ENCODER"
	default "1"
config VORBIS_ENCODER
	int "VORBIS_ENCODER"
	default "1"
config WMAV1_ENCODER
	int "WMAV1_ENCODER"
	default "1"
config WMAV2_ENCODER
	int "WMAV2_ENCODER"
	default "1"
config PCM_ALAW_ENCODER
	int "PCM_ALAW_ENCODER"
	default "1"
config PCM_F32BE_ENCODER
	int "PCM_F32BE_ENCODER"
	default "1"
config PCM_F32LE_ENCODER
	int "PCM_F32LE_ENCODER"
	default "1"
config PCM_F64BE_ENCODER
	int "PCM_F64BE_ENCODER"
	default "1"
config PCM_F64LE_ENCODER
	int "PCM_F64LE_ENCODER"
	default "1"
config PCM_MULAW_ENCODER
	int "PCM_MULAW_ENCODER"
	default "1"
config PCM_S8_ENCODER
	int "PCM_S8_ENCODER"
	default "1"
config PCM_S16BE_ENCODER
	int "PCM_S16BE_ENCODER"
	default "1"
config PCM_S16LE_ENCODER
	int "PCM_S16LE_ENCODER"
	default "1"
config PCM_S24BE_ENCODER
	int "PCM_S24BE_ENCODER"
	default "1"
config PCM_S24DAUD_ENCODER
	int "PCM_S24DAUD_ENCODER"
	default "1"
config PCM_S24LE_ENCODER
	int "PCM_S24LE_ENCODER"
	default "1"
config PCM_S32BE_ENCODER
	int "PCM_S32BE_ENCODER"
	default "1"
config PCM_S32LE_ENCODER
	int "PCM_S32LE_ENCODER"
	default "1"
config PCM_U8_ENCODER
	int "PCM_U8_ENCODER"
	default "1"
config PCM_U16BE_ENCODER
	int "PCM_U16BE_ENCODER"
	default "1"
config PCM_U16LE_ENCODER
	int "PCM_U16LE_ENCODER"
	default "1"
config PCM_U24BE_ENCODER
	int "PCM_U24BE_ENCODER"
	default "1"
config PCM_U24LE_ENCODER
	int "PCM_U24LE_ENCODER"
	default "1"
config PCM_U32BE_ENCODER
	int "PCM_U32BE_ENCODER"
	default "1"
config PCM_U32LE_ENCODER
	int "PCM_U32LE_ENCODER"
	default "1"
config PCM_ZORK_ENCODER
	int "PCM_ZORK_ENCODER"
	default "1"
config ROQ_DPCM_ENCODER
	int "ROQ_DPCM_ENCODER"
	default "1"
config ADPCM_ADX_ENCODER
	int "ADPCM_ADX_ENCODER"
	default "1"
config ADPCM_G726_ENCODER
	int "ADPCM_G726_ENCODER"
	default "1"
config ADPCM_IMA_QT_ENCODER
	int "ADPCM_IMA_QT_ENCODER"
	default "1"
config ADPCM_IMA_WAV_ENCODER
	int "ADPCM_IMA_WAV_ENCODER"
	default "1"
config ADPCM_MS_ENCODER
	int "ADPCM_MS_ENCODER"
	default "1"
config ADPCM_SWF_ENCODER
	int "ADPCM_SWF_ENCODER"
	default "1"
config ADPCM_YAMAHA_ENCODER
	int "ADPCM_YAMAHA_ENCODER"
	default "1"
config DVBSUB_ENCODER
	int "DVBSUB_ENCODER"
	default "1"
config DVDSUB_ENCODER
	int "DVDSUB_ENCODER"
	default "1"
config XSUB_ENCODER
	int "XSUB_ENCODER"
	default "1"
config LIBFAAC_ENCODER
	int "LIBFAAC_ENCODER"
	default "0"
config LIBXVID_ENCODER
	int "LIBXVID_ENCODER"
	default "0"
config LIBDIRAC_ENCODER
	int "LIBDIRAC_ENCODER"
	default "0"
config LIBSCHROEDINGER_ENCODER
	int "LIBSCHROEDINGER_ENCODER"
	default "0"
config LIBMP3LAME_ENCODER
	int "LIBMP3LAME_ENCODER"
	default "0"

config AAC_ENCODER
	int "AAC_ENCODER"
	default "0"
config LIBGSM_ENCODER
	int "LIBGSM_ENCODER"
	default "0"
config LIBGSM_MS_ENCODER
	int "LIBGSM_MS_ENCODER"
	default "0"
config LIBOPENCORE_AMRNB_ENCODER
	int "LIBOPENCORE_AMRNB_ENCODER"
	default "0"
config LIBTHEORA_ENCODER
	int "LIBTHEORA_ENCODER"
	default "0"
config LIBVORBIS_ENCODER
	int "LIBVORBIS_ENCODER"
	default "0"
config LIBX264_ENCODER
	int "LIBX264_ENCODER"
	default "0"
```
