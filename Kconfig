## Kconfig
```kconfig
menuconfig MPLAYER
	bool "mplayer"
	default n
	help
	  MPlayer - The Movie Player

if MPLAYER
menu "Features"
source Kconfig.features
endmenu

menuconfig DECODERS
	bool "Decoders"
	default y
if DECODERS
source Kconfig.decoders
endif

menuconfig ENCODERS
	bool "Encoders"
	default y
if ENCODERS
source Kconfig.encoders
endif

menu "Parsers"
source Kconfig.parsers
endmenu

menuconfig DEMUXERS
	bool "Demuxers"
	default y
if DEMUXERS
source Kconfig.demuxers
endif

menuconfig MUXERS
	bool "Muxers"
	default y
if MUXERS
source Kconfig.muxers
endif

menu "BSF"
source Kconfig.bsf
endmenu
endif
```

## Kconfig.bsf
```kconfig
config AAC_ADTSTOASC_BSF
	bool "AAC_ADTSTOASC_BSF"
	default y
config DUMP_EXTRADATA_BSF
	bool "DUMP_EXTRADATA_BSF"
	default y
config H264_MP4TOANNEXB_BSF
	bool "H264_MP4TOANNEXB_BSF"
	default y
config IMX_DUMP_HEADER_BSF
	bool "IMX_DUMP_HEADER_BSF"
	default y
config MJPEGA_DUMP_HEADER_BSF
	bool "MJPEGA_DUMP_HEADER_BSF"
	default y
config MP3_HEADER_COMPRESS_BSF
	bool "MP3_HEADER_COMPRESS_BSF"
	default y
config MP3_HEADER_DECOMPRESS_BSF
	bool "MP3_HEADER_DECOMPRESS_BSF"
	default y
config MOV2TEXTSUB_BSF
	bool "MOV2TEXTSUB_BSF"
	default y
config NOISE_BSF
	bool "NOISE_BSF"
	default y
config REMOVE_EXTRADATA_BSF
	bool "REMOVE_EXTRADATA_BSF"
	default y
config TEXT2MOVSUB_BSF
	bool "TEXT2MOVSUB_BSF"
	default y
```
