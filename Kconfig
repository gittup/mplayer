## Kconfig.decoders
```kconfig
config AASC_DECODER
	int "AASC_DECODER"
	default "1"
config AMV_DECODER
	int "AMV_DECODER"
	default "1"
config ASV1_DECODER
	int "ASV1_DECODER"
	default "1"
config ASV2_DECODER
	int "ASV2_DECODER"
	default "1"
config AVS_DECODER
	int "AVS_DECODER"
	default "1"
config BETHSOFTVID_DECODER
	int "BETHSOFTVID_DECODER"
	default "1"
config BFI_DECODER
	int "BFI_DECODER"
	default "1"
config BMP_DECODER
	int "BMP_DECODER"
	default "1"
config C93_DECODER
	int "C93_DECODER"
	default "1"
config CAVS_DECODER
	int "CAVS_DECODER"
	default "0"
config CINEPAK_DECODER
	int "CINEPAK_DECODER"
	default "1"
config CLJR_DECODER
	int "CLJR_DECODER"
	default "1"
config CSCD_DECODER
	int "CSCD_DECODER"
	default "1"
config CYUV_DECODER
	int "CYUV_DECODER"
	default "1"
config DNXHD_DECODER
	int "DNXHD_DECODER"
	default "1"
config DPX_DECODER
	int "DPX_DECODER"
	default "1"
config DSICINVIDEO_DECODER
	int "DSICINVIDEO_DECODER"
	default "1"
config DVVIDEO_DECODER
	int "DVVIDEO_DECODER"
	default "1"
config DXA_DECODER
	int "DXA_DECODER"
	default "1"
config EACMV_DECODER
	int "EACMV_DECODER"
	default "1"
config EAMAD_DECODER
	int "EAMAD_DECODER"
	default "0"
config EATGQ_DECODER
	int "EATGQ_DECODER"
	default "1"
config EATGV_DECODER
	int "EATGV_DECODER"
	default "1"
config EATQI_DECODER
	int "EATQI_DECODER"
	default "0"
config EIGHTBPS_DECODER
	int "EIGHTBPS_DECODER"
	default "1"
config EIGHTSVX_EXP_DECODER
	int "EIGHTSVX_EXP_DECODER"
	default "1"
config EIGHTSVX_FIB_DECODER
	int "EIGHTSVX_FIB_DECODER"
	default "1"
config ESCAPE124_DECODER
	int "ESCAPE124_DECODER"
	default "1"
config FFV1_DECODER
	int "FFV1_DECODER"
	default "1"
config FFVHUFF_DECODER
	int "FFVHUFF_DECODER"
	default "1"
config FLASHSV_DECODER
	int "FLASHSV_DECODER"
	default "1"
config FLIC_DECODER
	int "FLIC_DECODER"
	default "1"
config FLV_DECODER
	int "FLV_DECODER"
	default "0"
config FOURXM_DECODER
	int "FOURXM_DECODER"
	default "1"
config FRAPS_DECODER
	int "FRAPS_DECODER"
	default "1"
config FRWU_DECODER
	int "FRWU_DECODER"
	default "1"
config GIF_DECODER
	int "GIF_DECODER"
	default "1"
config H261_DECODER
	int "H261_DECODER"
	default "0"
config H263_DECODER
	int "H263_DECODER"
	default "0"
config H263I_DECODER
	int "H263I_DECODER"
	default "0"
config H264_DECODER
	int "H264_DECODER"
	default "0"
config HUFFYUV_DECODER
	int "HUFFYUV_DECODER"
	default "1"
config IDCIN_DECODER
	int "IDCIN_DECODER"
	default "1"
config INDEO2_DECODER
	int "INDEO2_DECODER"
	default "1"
config INDEO3_DECODER
	int "INDEO3_DECODER"
	default "1"
config INTERPLAY_VIDEO_DECODER
	int "INTERPLAY_VIDEO_DECODER"
	default "1"
config JPEGLS_DECODER
	int "JPEGLS_DECODER"
	default "1"
config KMVC_DECODER
	int "KMVC_DECODER"
	default "1"
config LOCO_DECODER
	int "LOCO_DECODER"
	default "1"
config MDEC_DECODER
	int "MDEC_DECODER"
	default "0"
config MIMIC_DECODER
	int "MIMIC_DECODER"
	default "1"
config MJPEG_DECODER
	int "MJPEG_DECODER"
	default "1"
config MJPEGB_DECODER
	int "MJPEGB_DECODER"
	default "1"
config MMVIDEO_DECODER
	int "MMVIDEO_DECODER"
	default "1"
config MOTIONPIXELS_DECODER
	int "MOTIONPIXELS_DECODER"
	default "1"
config MPEG1VIDEO_DECODER
	int "MPEG1VIDEO_DECODER"
	default "0"
config MPEG2VIDEO_DECODER
	int "MPEG2VIDEO_DECODER"
	default "0"
config MPEG4_DECODER
	int "MPEG4_DECODER"
	default "0"
config MPEGVIDEO_DECODER
	int "MPEGVIDEO_DECODER"
	default "0"
config MSMPEG4V1_DECODER
	int "MSMPEG4V1_DECODER"
	default "0"
config MSMPEG4V2_DECODER
	int "MSMPEG4V2_DECODER"
	default "0"
config MSMPEG4V3_DECODER
	int "MSMPEG4V3_DECODER"
	default "0"
config MSRLE_DECODER
	int "MSRLE_DECODER"
	default "1"
config MSVIDEO1_DECODER
	int "MSVIDEO1_DECODER"
	default "1"
config MSZH_DECODER
	int "MSZH_DECODER"
	default "1"
config NUV_DECODER
	int "NUV_DECODER"
	default "1"
config PAM_DECODER
	int "PAM_DECODER"
	default "1"
config PBM_DECODER
	int "PBM_DECODER"
	default "1"
config PCX_DECODER
	int "PCX_DECODER"
	default "1"
config PGM_DECODER
	int "PGM_DECODER"
	default "1"
config PGMYUV_DECODER
	int "PGMYUV_DECODER"
	default "1"
config PNG_DECODER
	int "PNG_DECODER"
	default "1"
config PPM_DECODER
	int "PPM_DECODER"
	default "1"
config PTX_DECODER
	int "PTX_DECODER"
	default "1"
config QDRAW_DECODER
	int "QDRAW_DECODER"
	default "1"
config QPEG_DECODER
	int "QPEG_DECODER"
	default "1"
config QTRLE_DECODER
	int "QTRLE_DECODER"
	default "1"
config RAWVIDEO_DECODER
	int "RAWVIDEO_DECODER"
	default "1"
config RL2_DECODER
	int "RL2_DECODER"
	default "1"
config ROQ_DECODER
	int "ROQ_DECODER"
	default "1"
config RPZA_DECODER
	int "RPZA_DECODER"
	default "1"
config RV10_DECODER
	int "RV10_DECODER"
	default "0"
config RV20_DECODER
	int "RV20_DECODER"
	default "0"
config RV30_DECODER
	int "RV30_DECODER"
	default "0"
config RV40_DECODER
	int "RV40_DECODER"
	default "0"
config SGI_DECODER
	int "SGI_DECODER"
	default "1"
config SMACKER_DECODER
	int "SMACKER_DECODER"
	default "1"
config SMC_DECODER
	int "SMC_DECODER"
	default "1"
config SNOW_DECODER
	int "SNOW_DECODER"
	default "1"
config SP5X_DECODER
	int "SP5X_DECODER"
	default "1"
config SUNRAST_DECODER
	int "SUNRAST_DECODER"
	default "1"
config SVQ1_DECODER
	int "SVQ1_DECODER"
	default "0"
config SVQ3_DECODER
	int "SVQ3_DECODER"
	default "0"
config TARGA_DECODER
	int "TARGA_DECODER"
	default "1"
config THEORA_DECODER
	int "THEORA_DECODER"
	default "1"
config THP_DECODER
	int "THP_DECODER"
	default "1"
config TIERTEXSEQVIDEO_DECODER
	int "TIERTEXSEQVIDEO_DECODER"
	default "1"
config TIFF_DECODER
	int "TIFF_DECODER"
	default "1"
config TMV_DECODER
	int "TMV_DECODER"
	default "1"
config TRUEMOTION1_DECODER
	int "TRUEMOTION1_DECODER"
	default "1"
config TRUEMOTION2_DECODER
	int "TRUEMOTION2_DECODER"
	default "1"
config TSCC_DECODER
	int "TSCC_DECODER"
	default "1"
config TXD_DECODER
	int "TXD_DECODER"
	default "1"
config ULTI_DECODER
	int "ULTI_DECODER"
	default "1"
config V210_DECODER
	int "V210_DECODER"
	default "1"
config V210X_DECODER
	int "V210X_DECODER"
	default "1"
config VB_DECODER
	int "VB_DECODER"
	default "1"
config VC1_DECODER
	int "VC1_DECODER"
	default "0"
config VCR1_DECODER
	int "VCR1_DECODER"
	default "1"
config VMDVIDEO_DECODER
	int "VMDVIDEO_DECODER"
	default "1"
config VMNC_DECODER
	int "VMNC_DECODER"
	default "1"
config VP3_DECODER
	int "VP3_DECODER"
	default "1"
config VP5_DECODER
	int "VP5_DECODER"
	default "1"
config VP6_DECODER
	int "VP6_DECODER"
	default "1"
config VP6A_DECODER
	int "VP6A_DECODER"
	default "1"
config VP6F_DECODER
	int "VP6F_DECODER"
	default "1"
config VQA_DECODER
	int "VQA_DECODER"
	default "1"
config WMV1_DECODER
	int "WMV1_DECODER"
	default "0"
config WMV2_DECODER
	int "WMV2_DECODER"
	default "0"
config WMV3_DECODER
	int "WMV3_DECODER"
	default "0"
config WNV1_DECODER
	int "WNV1_DECODER"
	default "1"
config XAN_WC3_DECODER
	int "XAN_WC3_DECODER"
	default "1"
config XL_DECODER
	int "XL_DECODER"
	default "1"
config ZLIB_DECODER
	int "ZLIB_DECODER"
	default "1"
config ZMBV_DECODER
	int "ZMBV_DECODER"
	default "1"
config AAC_DECODER
	int "AAC_DECODER"
	default "1"
config AC3_DECODER
	int "AC3_DECODER"
	default "1"
config ALAC_DECODER
	int "ALAC_DECODER"
	default "1"
config APE_DECODER
	int "APE_DECODER"
	default "1"
config ATRAC1_DECODER
	int "ATRAC1_DECODER"
	default "1"
config ATRAC3_DECODER
	int "ATRAC3_DECODER"
	default "1"
config COOK_DECODER
	int "COOK_DECODER"
	default "1"
config DCA_DECODER
	int "DCA_DECODER"
	default "1"
config DSICINAUDIO_DECODER
	int "DSICINAUDIO_DECODER"
	default "1"
config EAC3_DECODER
	int "EAC3_DECODER"
	default "1"
config FLAC_DECODER
	int "FLAC_DECODER"
	default "1"
config IMC_DECODER
	int "IMC_DECODER"
	default "1"
config MACE3_DECODER
	int "MACE3_DECODER"
	default "1"
config MACE6_DECODER
	int "MACE6_DECODER"
	default "1"
config MLP_DECODER
	int "MLP_DECODER"
	default "1"
config MP1_DECODER
	int "MP1_DECODER"
	default "1"
config MP2_DECODER
	int "MP2_DECODER"
	default "1"
config MP3_DECODER
	int "MP3_DECODER"
	default "1"
config MP3ADU_DECODER
	int "MP3ADU_DECODER"
	default "1"
config MP3ON4_DECODER
	int "MP3ON4_DECODER"
	default "1"
config MPC7_DECODER
	int "MPC7_DECODER"
	default "1"
config MPC8_DECODER
	int "MPC8_DECODER"
	default "1"
config NELLYMOSER_DECODER
	int "NELLYMOSER_DECODER"
	default "1"
config QCELP_DECODER
	int "QCELP_DECODER"
	default "1"
config QDM2_DECODER
	int "QDM2_DECODER"
	default "1"
config RA_144_DECODER
	int "RA_144_DECODER"
	default "1"
config RA_288_DECODER
	int "RA_288_DECODER"
	default "1"
config SHORTEN_DECODER
	int "SHORTEN_DECODER"
	default "1"
config SMACKAUD_DECODER
	int "SMACKAUD_DECODER"
	default "1"
config SONIC_DECODER
	int "SONIC_DECODER"
	default "1"
config TRUEHD_DECODER
	int "TRUEHD_DECODER"
	default "1"
config TRUESPEECH_DECODER
	int "TRUESPEECH_DECODER"
	default "1"
config TTA_DECODER
	int "TTA_DECODER"
	default "1"
config TWINVQ_DECODER
	int "TWINVQ_DECODER"
	default "1"
config VMDAUDIO_DECODER
	int "VMDAUDIO_DECODER"
	default "1"
config VORBIS_DECODER
	int "VORBIS_DECODER"
	default "1"
config WAVPACK_DECODER
	int "WAVPACK_DECODER"
	default "1"
config WMAPRO_DECODER
	int "WMAPRO_DECODER"
	default "1"
config WMAV1_DECODER
	int "WMAV1_DECODER"
	default "1"
config WMAV2_DECODER
	int "WMAV2_DECODER"
	default "1"
config WS_SND1_DECODER
	int "WS_SND1_DECODER"
	default "1"
config PCM_ALAW_DECODER
	int "PCM_ALAW_DECODER"
	default "1"
config PCM_BLURAY_DECODER
	int "PCM_BLURAY_DECODER"
	default "1"
config PCM_DVD_DECODER
	int "PCM_DVD_DECODER"
	default "1"
config PCM_F32BE_DECODER
	int "PCM_F32BE_DECODER"
	default "1"
config PCM_F32LE_DECODER
	int "PCM_F32LE_DECODER"
	default "1"
config PCM_F64BE_DECODER
	int "PCM_F64BE_DECODER"
	default "1"
config PCM_F64LE_DECODER
	int "PCM_F64LE_DECODER"
	default "1"
config PCM_MULAW_DECODER
	int "PCM_MULAW_DECODER"
	default "1"
config PCM_S8_DECODER
	int "PCM_S8_DECODER"
	default "1"
config PCM_S16BE_DECODER
	int "PCM_S16BE_DECODER"
	default "1"
config PCM_S16LE_DECODER
	int "PCM_S16LE_DECODER"
	default "1"
config PCM_S16LE_PLANAR_DECODER
	int "PCM_S16LE_PLANAR_DECODER"
	default "1"
config PCM_S24BE_DECODER
	int "PCM_S24BE_DECODER"
	default "1"
config PCM_S24DAUD_DECODER
	int "PCM_S24DAUD_DECODER"
	default "1"
config PCM_S24LE_DECODER
	int "PCM_S24LE_DECODER"
	default "1"
config PCM_S32BE_DECODER
	int "PCM_S32BE_DECODER"
	default "1"
config PCM_S32LE_DECODER
	int "PCM_S32LE_DECODER"
	default "1"
config PCM_U8_DECODER
	int "PCM_U8_DECODER"
	default "1"
config PCM_U16BE_DECODER
	int "PCM_U16BE_DECODER"
	default "1"
config PCM_U16LE_DECODER
	int "PCM_U16LE_DECODER"
	default "1"
config PCM_U24BE_DECODER
	int "PCM_U24BE_DECODER"
	default "1"
config PCM_U24LE_DECODER
	int "PCM_U24LE_DECODER"
	default "1"
config PCM_U32BE_DECODER
	int "PCM_U32BE_DECODER"
	default "1"
config PCM_U32LE_DECODER
	int "PCM_U32LE_DECODER"
	default "1"
config PCM_ZORK_DECODER
	int "PCM_ZORK_DECODER"
	default "1"
config INTERPLAY_DPCM_DECODER
	int "INTERPLAY_DPCM_DECODER"
	default "1"
config ROQ_DPCM_DECODER
	int "ROQ_DPCM_DECODER"
	default "1"
config SOL_DPCM_DECODER
	int "SOL_DPCM_DECODER"
	default "1"
config XAN_DPCM_DECODER
	int "XAN_DPCM_DECODER"
	default "1"
config ADPCM_4XM_DECODER
	int "ADPCM_4XM_DECODER"
	default "1"
config ADPCM_ADX_DECODER
	int "ADPCM_ADX_DECODER"
	default "1"
config ADPCM_CT_DECODER
	int "ADPCM_CT_DECODER"
	default "1"
config ADPCM_EA_DECODER
	int "ADPCM_EA_DECODER"
	default "1"
config ADPCM_EA_MAXIS_XA_DECODER
	int "ADPCM_EA_MAXIS_XA_DECODER"
	default "1"
config ADPCM_EA_R1_DECODER
	int "ADPCM_EA_R1_DECODER"
	default "1"
config ADPCM_EA_R2_DECODER
	int "ADPCM_EA_R2_DECODER"
	default "1"
config ADPCM_EA_R3_DECODER
	int "ADPCM_EA_R3_DECODER"
	default "1"
config ADPCM_EA_XAS_DECODER
	int "ADPCM_EA_XAS_DECODER"
	default "1"
config ADPCM_G726_DECODER
	int "ADPCM_G726_DECODER"
	default "1"
config ADPCM_IMA_AMV_DECODER
	int "ADPCM_IMA_AMV_DECODER"
	default "1"
config ADPCM_IMA_DK3_DECODER
	int "ADPCM_IMA_DK3_DECODER"
	default "1"
config ADPCM_IMA_DK4_DECODER
	int "ADPCM_IMA_DK4_DECODER"
	default "1"
config ADPCM_IMA_EA_EACS_DECODER
	int "ADPCM_IMA_EA_EACS_DECODER"
	default "1"
config ADPCM_IMA_EA_SEAD_DECODER
	int "ADPCM_IMA_EA_SEAD_DECODER"
	default "1"
config ADPCM_IMA_ISS_DECODER
	int "ADPCM_IMA_ISS_DECODER"
	default "1"
config ADPCM_IMA_QT_DECODER
	int "ADPCM_IMA_QT_DECODER"
	default "1"
config ADPCM_IMA_SMJPEG_DECODER
	int "ADPCM_IMA_SMJPEG_DECODER"
	default "1"
config ADPCM_IMA_WAV_DECODER
	int "ADPCM_IMA_WAV_DECODER"
	default "1"
config ADPCM_IMA_WS_DECODER
	int "ADPCM_IMA_WS_DECODER"
	default "1"
config ADPCM_MS_DECODER
	int "ADPCM_MS_DECODER"
	default "1"
config ADPCM_SBPRO_2_DECODER
	int "ADPCM_SBPRO_2_DECODER"
	default "1"
config ADPCM_SBPRO_3_DECODER
	int "ADPCM_SBPRO_3_DECODER"
	default "1"
config ADPCM_SBPRO_4_DECODER
	int "ADPCM_SBPRO_4_DECODER"
	default "1"
config ADPCM_SWF_DECODER
	int "ADPCM_SWF_DECODER"
	default "1"
config ADPCM_THP_DECODER
	int "ADPCM_THP_DECODER"
	default "1"
config ADPCM_XA_DECODER
	int "ADPCM_XA_DECODER"
	default "1"
config ADPCM_YAMAHA_DECODER
	int "ADPCM_YAMAHA_DECODER"
	default "1"
config DVBSUB_DECODER
	int "DVBSUB_DECODER"
	default "1"
config DVDSUB_DECODER
	int "DVDSUB_DECODER"
	default "1"
config PGSSUB_DECODER
	int "PGSSUB_DECODER"
	default "1"
config XSUB_DECODER
	int "XSUB_DECODER"
	default "1"
config LIBDIRAC_DECODER
	int "LIBDIRAC_DECODER"
	default "0"
config LIBSCHROEDINGER_DECODER
	int "LIBSCHROEDINGER_DECODER"
	default "0"

config H264_VDPAU_DECODER
	int "H264_VDPAU_DECODER"
	default "0"
config MPEG_XVMC_DECODER
	int "MPEG_XVMC_DECODER"
	default "0"
config MPEG_VDPAU_DECODER
	int "MPEG_VDPAU_DECODER"
	default "0"
config MPEG1_VDPAU_DECODER
	int "MPEG1_VDPAU_DECODER"
	default "0"
config MPEG4_VDPAU_DECODER
	int "MPEG4_VDPAU_DECODER"
	default "0"
config VC1_VDPAU_DECODER
	int "VC1_VDPAU_DECODER"
	default "0"
config WMV3_VDPAU_DECODER
	int "WMV3_VDPAU_DECODER"
	default "0"
config LIBFAAD_DECODER
	int "LIBFAAD_DECODER"
	default "0"
config LIBGSM_DECODER
	int "LIBGSM_DECODER"
	default "0"
config LIBGSM_MS_DECODER
	int "LIBGSM_MS_DECODER"
	default "0"
config LIBOPENCORE_AMRNB_DECODER
	int "LIBOPENCORE_AMRNB_DECODER"
	default "0"
config LIBOPENCORE_AMRWB_DECODER
	int "LIBOPENCORE_AMRWB_DECODER"
	default "0"
config LIBOPENJPEG_DECODER
	int "LIBOPENJPEG_DECODER"
	default "0"
config LIBSPEEX_DECODER
	int "LIBSPEEX_DECODER"
	default "0"
config ALS_DECODER
	int "ALS_DECODER"
	default "0"
config CDGRAPHICS_DECODER
	int "CDGRAPHICS_DECODER"
	default "0"
config R210_DECODER
	int "R210_DECODER"
	default "0"
config AURA_DECODER
	int "AURA_DECODER"
	default "0"
config AURA2_DECODER
	int "AURA2_DECODER"
	default "0"
config ANM_DECODER
	int "ANM_DECODER"
	default "0"
config SIPR_DECODER
	int "SIPR_DECODER"
	default "0"
```
