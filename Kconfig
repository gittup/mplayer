## Kconfig.features
```kconfig
config 3DFX
	bool "3DFX"
	default n
config AA
	bool "AA"
	default n
config ALSA1X
	bool "ALSA1X"
	default y
config APPLE_IR
	bool "APPLE_IR"
	default n
config APPLE_REMOTE
	bool "APPLE_REMOTE"
	default n
config ARTS
	bool "ARTS"
	default n
config AUDIO_INPUT
	bool "AUDIO_INPUT"
	default y
config BITMAP_FONT
	bool "BITMAP_FONT"
	default y
config BL
	bool "BL"
	default n
config CACA
	bool "CACA"
	default n
config CDDA
	bool "CDDA"
	default n
config CDDB
	bool "CDDB"
	default n
config COREAUDIO
	bool "COREAUDIO"
	default n
config COREVIDEO
	bool "COREVIDEO"
	default n
config DART
	bool "DART"
	default n
config DGA
	bool "DGA"
	default n
config DIRECT3D
	bool "DIRECT3D"
	default n
config DIRECTFB
	bool "DIRECTFB"
	default n
config DIRECTX
	bool "DIRECTX"
	default n
config DVBIN
	bool "DVBIN"
	default n
config DVDNAV
	bool "DVDNAV"
	default n
config DVDNAV_INTERNAL
	bool "DVDNAV_INTERNAL"
	default n
config DVDREAD
	bool "DVDREAD"
	default n
config DVDREAD_INTERNAL
	bool "DVDREAD_INTERNAL"
	default n
config DXR2
	bool "DXR2"
	default n
config DXR3
	bool "DXR3"
	default n
config ESD
	bool "ESD"
	default n
config FAAC
	bool "FAAC"
	default n
config FAAD
	bool "FAAD"
	default n
config FAAD_INTERNAL
	bool "FAAD_INTERNAL"
	default n
config FASTMEMCPY
	bool "FASTMEMCPY"
	default y
config FBDEV
	bool "FBDEV"
	default y
config FREETYPE
	bool "FREETYPE"
	default n
config FTP
	bool "FTP"
	default y
config GIF
	bool "GIF"
	default n
config GGI
	bool "GGI"
	default n
config GL
	bool "GL"
	default n
config GUI
	bool "GUI"
	default n
config HAVE_POSIX_SELECT
	bool "HAVE_POSIX_SELECT"
	default y
config HAVE_SYS_MMAN_H
	bool "HAVE_SYS_MMAN_H"
	default y
config IVTV
	bool "IVTV"
	default n
config JACK
	bool "JACK"
	default n
config JOYSTICK
	bool "JOYSTICK"
	default n
config JPEG
	bool "JPEG"
	default n
config KVA
	bool "KVA"
	default n
config LADSPA
	bool "LADSPA"
	default n
config LIBA52
	bool "LIBA52"
	default y
config LIBA52_INTERNAL
	bool "LIBA52_INTERNAL"
	default y
config LIBASS
	bool "LIBASS"
	default n
config LIBBS2B
	bool "LIBBS2B"
	default n
config LIBDCA
	bool "LIBDCA"
	default n
config LIBDV
	bool "LIBDV"
	default n
config LIBDVDCSS_INTERNAL
	bool "LIBDVDCSS_INTERNAL"
	default n
config LIBLZO
	bool "LIBLZO"
	default n
config LIBMAD
	bool "LIBMAD"
	default n
config LIBMENU
	bool "LIBMENU"
	default n
config LIBMENU_DVBIN
	bool "LIBMENU_DVBIN"
	default n
config LIBMPEG2
	bool "LIBMPEG2"
	default n
config LIBNEMESI
	bool "LIBNEMESI"
	default n
config LIBNUT
	bool "LIBNUT"
	default n
config LIBSMBCLIENT
	bool "LIBSMBCLIENT"
	default n
config LIBTHEORA
	bool "LIBTHEORA"
	default n
config LIRC
	bool "LIRC"
	default n
config LIVE555
	bool "LIVE555"
	default n
config MPLAYER_MD5SUM
	bool "MPLAYER_MD5SUM"
	default y
config MGA
	bool "MGA"
	default n
config MNG
	bool "MNG"
	default n
config MP3LAME
	bool "MP3LAME"
	default y
config MP3LIB
	bool "MP3LIB"
	default y
config MUSEPACK
	bool "MUSEPACK"
	default n
config NAS
	bool "NAS"
	default n
config NATIVE_RTSP
	bool "NATIVE_RTSP"
	default y
config NEED_SHMEM
	bool "NEED_SHMEM"
	default y
config NETWORK
	bool "NETWORK"
	default y
config OPENAL
	bool "OPENAL"
	default n
config OSS
	bool "OSS"
	default y
config PNG
	bool "PNG"
	default n
config PNM
	bool "PNM"
	default n
config PRIORITY
	bool "PRIORITY"
	default n
config PULSE
	bool "PULSE"
	default n
config PVR
	bool "PVR"
	default y
config QTX_CODECS
	bool "QTX_CODECS"
	default n
config QTX_EMULATION
	bool "QTX_EMULATION"
	default n
config RADIO
	bool "RADIO"
	default n
config RADIO_CAPTURE
	bool "RADIO_CAPTURE"
	default n
config REAL_CODECS
	bool "REAL_CODECS"
	default n
config S3FB
	bool "S3FB"
	default n
config SDL
	bool "SDL"
	default n
config SPEEX
	bool "SPEEX"
	default n
config STREAM_CACHE
	bool "STREAM_CACHE"
	default y
config SGIAUDIO
	bool "SGIAUDIO"
	default n
config SUNAUDIO
	bool "SUNAUDIO"
	default n
config SVGA
	bool "SVGA"
	default n
config TDFXFB
	bool "TDFXFB"
	default n
config TDFXVID
	bool "TDFXVID"
	default n
config TGA
	bool "TGA"
	default y
config TOOLAME
	bool "TOOLAME"
	default n
config TREMOR_INTERNAL
	bool "TREMOR_INTERNAL"
	default n
config TV
	bool "TV"
	default y
config TV_BSDBT848
	bool "TV_BSDBT848"
	default n
config TV_DSHOW
	bool "TV_DSHOW"
	default n
config TV_TELETEXT
	bool "TV_TELETEXT"
	default n
config TV_V4L 
	bool "TV_V4L"
	default y
config TV_V4L1
	bool "TV_V4L1"
	default y
config TV_V4L2
	bool "TV_V4L2"
	default y
config TWOLAME
	bool "TWOLAME"
	default y
config UNRAR_EXEC
	bool "UNRAR_EXEC"
	default y
config V4L2
	bool "V4L2"
	default y
config VCD
	bool "VCD"
	default n
config VDPAU
	int "VDPAU"
	default "0"
config VESA
	bool "VESA"
	default n
config VIDIX
	bool "VIDIX"
	default n
config VIDIX_PCIDB
	bool "VIDIX_PCIDB"
	default 0
config VIDIX_CYBERBLADE
	bool "VIDIX_CYBERBLADE"
	default n
config VIDIX_IVTV
	bool "VIDIX_IVTV"
	default n
config VIDIX_MACH64
	bool "VIDIX_MACH64"
	default n
config VIDIX_MGA
	bool "VIDIX_MGA"
	default n
config VIDIX_MGA_CRTC2
	bool "VIDIX_MGA_CRTC2"
	default n
config VIDIX_NVIDIA
	bool "VIDIX_NVIDIA"
	default n
config VIDIX_PM2
	bool "VIDIX_PM2"
	default n
config VIDIX_PM3
	bool "VIDIX_PM3"
	default n
config VIDIX_RADEON
	bool "VIDIX_RADEON"
	default n
config VIDIX_RAGE128
	bool "VIDIX_RAGE128"
	default n
config VIDIX_S3
	bool "VIDIX_S3"
	default n
config VIDIX_SH_VEU
	bool "VIDIX_SH_VEU"
	default n
config VIDIX_SIS
	bool "VIDIX_SIS"
	default n
config VIDIX_UNICHROME
	bool "VIDIX_UNICHROME"
	default n
config VORBIS
	bool "VORBIS"
	default n
config VSTREAM
	bool "VSTREAM"
	default n
config WII
	bool "WII"
	default n
config WIN32DLL
	bool "WIN32DLL"
	default n
config WIN32WAVEOUT
	bool "WIN32WAVEOUT"
	default n
config WIN32_EMULATION
	bool "WIN32_EMULATION"
	default n
config X11
	bool "X11"
	default n
config X264
	bool "X264"
	default n
config XANIM_CODECS
	bool "XANIM_CODECS"
	default n
config XMGA
	bool "XMGA"
	default n
config XMMS_PLUGINS
	bool "XMMS_PLUGINS"
	default n
config XV
	bool "XV"
	default n
config XVID4
	bool "XVID4"
	default n
config XVIDIX
	bool "XVIDIX"
	default n
config XVMC
	int "XVMC"
	default "0"
config XVR100
	bool "XVR100"
	default n
config YUV4MPEG
	bool "YUV4MPEG"
	default n
config ZR
	bool "ZR"
	default n

# Added by me
config ARCH_X86_32
	bool "ARCH_X86_32"
	default y
config OSS_AUDIO
	bool "OSS_AUDIO"
	default y
config AANDCT
	bool "AANDCT"
	default y
config FFT
	bool "FFT"
	default y
config GOLOMB
	bool "GOLOMB"
	default y
config LPC
	bool "LPC"
	default y
config MDCT
	bool "MDCT"
	default y
config RDFT
	bool "RDFT"
	default y

config LIBAVUTIL
	bool "LIBAVUTIL"
	default y
config LIBAVUTIL_A
	bool "LIBAVUTIL_A"
	default y
config LIBAVCODEC
	bool "LIBAVCODEC"
	default y
config LIBAVCODEC_A
	bool "LIBAVCODEC_A"
	default y
config LIBAVFORMAT
	bool "LIBAVFORMAT"
	default y
config LIBAVFORMAT_A
	bool "LIBAVFORMAT_A"
	default y
config LIBPOSTPROC
	bool "LIBPOSTPROC"
	default n
config LIBPOSTPROC_A
	bool "LIBPOSTPROC_A"
	default n
config LIBSWSCALE
	bool "LIBSWSCALE"
	default y
config LIBSWSCALE_A
	bool "LIBSWSCALE_A"
	default y

config FILE_PROTOCOL
	int "FILE_PROTOCOL"
	default "0"
config GOPHER_PROTOCOL
	int "GOPHER_PROTOCOL"
	default "0"
config HTTP_PROTOCOL
	int "HTTP_PROTOCOL"
	default "0"
config PIPE_PROTOCOL
	int "PIPE_PROTOCOL"
	default "0"
config RTMP_PROTOCOL
	int "RTMP_PROTOCOL"
	default "0"
config RTP_PROTOCOL
	int "RTP_PROTOCOL"
	default "0"
config TCP_PROTOCOL
	int "TCP_PROTOCOL"
	default "0"
config UDP_PROTOCOL
	int "UDP_PROTOCOL"
	default "0"
config HAVE_MMX
	bool "HAVE_MMX"
	default y
config HAVE_SSE
	bool "HAVE_SSE"
	default y
config HAVE_SSE2
	bool "HAVE_SSE2"
	default y
config HAVE_YASM
	bool "HAVE_YASM"
	default y
config HAVE_PTHREADS
	bool "HAVE_PTHREADS"
	default y
config GPL
	bool "GPL"
	default y
config H264_DXVA2_HWACCEL
	int "H264_DXVA2_HWACCEL"
	default "0"
```

## Kconfig.muxers
```kconfig
config AC3_MUXER
	int "AC3_MUXER"
	default "1"
config ADTS_MUXER
	int "ADTS_MUXER"
	default "1"
config AIFF_MUXER
	int "AIFF_MUXER"
	default "1"
config AMR_MUXER
	int "AMR_MUXER"
	default "1"
config ASF_MUXER
	int "ASF_MUXER"
	default "1"
config ASS_MUXER
	int "ASS_MUXER"
	default "1"
config ASF_STREAM_MUXER
	int "ASF_STREAM_MUXER"
	default "1"
config AU_MUXER
	int "AU_MUXER"
	default "1"
config AVI_MUXER
	int "AVI_MUXER"
	default "1"
config AVM2_MUXER
	int "AVM2_MUXER"
	default "1"
config CRC_MUXER
	int "CRC_MUXER"
	default "1"
config DAUD_MUXER
	int "DAUD_MUXER"
	default "1"
config DIRAC_MUXER
	int "DIRAC_MUXER"
	default "1"
config DNXHD_MUXER
	int "DNXHD_MUXER"
	default "1"
config DTS_MUXER
	int "DTS_MUXER"
	default "1"
config DV_MUXER
	int "DV_MUXER"
	default "1"
config EAC3_MUXER
	int "EAC3_MUXER"
	default "1"
config FFM_MUXER
	int "FFM_MUXER"
	default "1"
config FLAC_MUXER
	int "FLAC_MUXER"
	default "1"
config FLV_MUXER
	int "FLV_MUXER"
	default "1"
config FRAMECRC_MUXER
	int "FRAMECRC_MUXER"
	default "1"
config GIF_MUXER
	int "GIF_MUXER"
	default "1"
config GXF_MUXER
	int "GXF_MUXER"
	default "1"
config H261_MUXER
	int "H261_MUXER"
	default "1"
config H263_MUXER
	int "H263_MUXER"
	default "1"
config H264_MUXER
	int "H264_MUXER"
	default "1"
config IMAGE2_MUXER
	int "IMAGE2_MUXER"
	default "1"
config IMAGE2PIPE_MUXER
	int "IMAGE2PIPE_MUXER"
	default "1"
config IPOD_MUXER
	int "IPOD_MUXER"
	default "1"
config M4V_MUXER
	int "M4V_MUXER"
	default "1"
config MATROSKA_MUXER
	int "MATROSKA_MUXER"
	default "1"
config MATROSKA_AUDIO_MUXER
	int "MATROSKA_AUDIO_MUXER"
	default "1"
config MJPEG_MUXER
	int "MJPEG_MUXER"
	default "1"
config MLP_MUXER
	int "MLP_MUXER"
	default "1"
config MMF_MUXER
	int "MMF_MUXER"
	default "1"
config MOV_MUXER
	int "MOV_MUXER"
	default "1"
config MP2_MUXER
	int "MP2_MUXER"
	default "1"
config MP3_MUXER
	int "MP3_MUXER"
	default "1"
config MP4_MUXER
	int "MP4_MUXER"
	default "1"
config MPEG1SYSTEM_MUXER
	int "MPEG1SYSTEM_MUXER"
	default "0"
config MPEG1VCD_MUXER
	int "MPEG1VCD_MUXER"
	default "0"
config MPEG1VIDEO_MUXER
	int "MPEG1VIDEO_MUXER"
	default "0"
config MPEG2DVD_MUXER
	int "MPEG2DVD_MUXER"
	default "0"
config MPEG2SVCD_MUXER
	int "MPEG2SVCD_MUXER"
	default "0"
config MPEG2VIDEO_MUXER
	int "MPEG2VIDEO_MUXER"
	default "0"
config MPEG2VOB_MUXER
	int "MPEG2VOB_MUXER"
	default "0"
config MPEGTS_MUXER
	int "MPEGTS_MUXER"
	default "0"
config MPJPEG_MUXER
	int "MPJPEG_MUXER"
	default "1"
config MXF_MUXER
	int "MXF_MUXER"
	default "1"
config MXF_D10_MUXER
	int "MXF_D10_MUXER"
	default "1"
config NULL_MUXER
	int "NULL_MUXER"
	default "1"
config NUT_MUXER
	int "NUT_MUXER"
	default "1"
config OGG_MUXER
	int "OGG_MUXER"
	default "1"
config PCM_ALAW_MUXER
	int "PCM_ALAW_MUXER"
	default "1"
config PCM_MULAW_MUXER
	int "PCM_MULAW_MUXER"
	default "1"
config PCM_F64BE_MUXER
	int "PCM_F64BE_MUXER"
	default "1"
config PCM_F64LE_MUXER
	int "PCM_F64LE_MUXER"
	default "1"
config PCM_F32BE_MUXER
	int "PCM_F32BE_MUXER"
	default "1"
config PCM_F32LE_MUXER
	int "PCM_F32LE_MUXER"
	default "1"
config PCM_S32BE_MUXER
	int "PCM_S32BE_MUXER"
	default "1"
config PCM_S32LE_MUXER
	int "PCM_S32LE_MUXER"
	default "1"
config PCM_S24BE_MUXER
	int "PCM_S24BE_MUXER"
	default "1"
config PCM_S24LE_MUXER
	int "PCM_S24LE_MUXER"
	default "1"
config PCM_S16BE_MUXER
	int "PCM_S16BE_MUXER"
	default "1"
config PCM_S16LE_MUXER
	int "PCM_S16LE_MUXER"
	default "1"
config PCM_S8_MUXER
	int "PCM_S8_MUXER"
	default "1"
config PCM_U32BE_MUXER
	int "PCM_U32BE_MUXER"
	default "1"
config PCM_U32LE_MUXER
	int "PCM_U32LE_MUXER"
	default "1"
config PCM_U24BE_MUXER
	int "PCM_U24BE_MUXER"
	default "1"
config PCM_U24LE_MUXER
	int "PCM_U24LE_MUXER"
	default "1"
config PCM_U16BE_MUXER
	int "PCM_U16BE_MUXER"
	default "1"
config PCM_U16LE_MUXER
	int "PCM_U16LE_MUXER"
	default "1"
config PCM_U8_MUXER
	int "PCM_U8_MUXER"
	default "1"
config PSP_MUXER
	int "PSP_MUXER"
	default "1"
config RAWVIDEO_MUXER
	int "RAWVIDEO_MUXER"
	default "1"
config RM_MUXER
	int "RM_MUXER"
	default "1"
config ROQ_MUXER
	int "ROQ_MUXER"
	default "1"
config SOX_MUXER
	int "SOX_MUXER"
	default "1"
config SPDIF_MUXER
	int "SPDIF_MUXER"
	default "1"
config SWF_MUXER
	int "SWF_MUXER"
	default "1"
config TG2_MUXER
	int "TG2_MUXER"
	default "1"
config TGP_MUXER
	int "TGP_MUXER"
	default "1"
config TRUEHD_MUXER
	int "TRUEHD_MUXER"
	default "1"
config VC1T_MUXER
	int "VC1T_MUXER"
	default "1"
config VOC_MUXER
	int "VOC_MUXER"
	default "1"
config WAV_MUXER
	int "WAV_MUXER"
	default "1"
config YUV4MPEGPIPE_MUXER
	int "YUV4MPEGPIPE_MUXER"
	default "0"

config RTP_MUXER
	int "RTP_MUXER"
	default "0"
config LIBNUT_MUXER
	int "LIBNUT_MUXER"
	default "0"
config FILMSTRIP_MUXER
	int "FILMSTRIP_MUXER"
	default "0"
```

## Kconfig.parsers
```kconfig
config AAC_PARSER
	int "AAC_PARSER"
	default "1"
config AC3_PARSER
	int "AC3_PARSER"
	default "1"
config CAVSVIDEO_PARSER
	int "CAVSVIDEO_PARSER"
	default "1"
config DCA_PARSER
	int "DCA_PARSER"
	default "1"
config DIRAC_PARSER
	int "DIRAC_PARSER"
	default "1"
config DNXHD_PARSER
	int "DNXHD_PARSER"
	default "1"
config DVBSUB_PARSER
	int "DVBSUB_PARSER"
	default "1"
config DVDSUB_PARSER
	int "DVDSUB_PARSER"
	default "1"
config H261_PARSER
	int "H261_PARSER"
	default "0"
config H263_PARSER
	int "H263_PARSER"
	default "0"
config H264_PARSER
	int "H264_PARSER"
	default "0"
config MJPEG_PARSER
	int "MJPEG_PARSER"
	default "1"
config MLP_PARSER
	int "MLP_PARSER"
	default "1"
config MPEG4VIDEO_PARSER
	int "MPEG4VIDEO_PARSER"
	default "0"
config MPEGAUDIO_PARSER
	int "MPEGAUDIO_PARSER"
	default "0"
config MPEGVIDEO_PARSER
	int "MPEGVIDEO_PARSER"
	default "0"
config PNM_PARSER
	int "PNM_PARSER"
	default "1"
config VC1_PARSER
	int "VC1_PARSER"
	default "0"
config VP3_PARSER
	int "VP3_PARSER"
	default "1"
```
